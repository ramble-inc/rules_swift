load(
    "@build_bazel_rules_swift//swift:swift.bzl",
    "swift_binary",
    "swift_library",
)
load(
    "@rules_cc//cc:defs.bzl",
    "cc_library",
)

cc_library(
    name="CGRPCZlib",
    srcs=glob([
        "Sources/CGRPCZlib/**/*.{swift,c,h,cc,S}",
    ]),
    hdrs=glob([
        "Sources/CGRPCZlib/include/*.h",
    ]),
    tags=["swift_module=CGRPCZlib"],
    visibility=["//visibility:public"],
)


swift_library(
    name="SwiftGRPC",
    srcs=glob([
        "Sources/GRPC/**/*.swift",
    ]),
    module_name="GRPC",
    visibility=["//visibility:public"],
    deps=[
        ":CGRPCZlib",
        "@com_github_apple_swift_protobuf//:SwiftProtobuf",
        "@com_github_apple_swift_nio//:NIO",
        "@com_github_apple_swift_nio//:NIOHTTP1",
        "@com_github_apple_swift_nio//:NIOFoundationCompat",
        "@com_github_apple_swift_nio_http2//:NIOHPACK",
        "@com_github_apple_swift_nio_http2//:NIOHTTP2",
        "@com_github_apple_swift_nio_ssl//:NIOSSL",
        "@com_github_apple_swift_nio_transport_services//:NIOTransportServices",
        "@com_github_apple_swift_log//:Logging",
    ],
)

swift_binary(
    name="protoc-gen-grpc-swift",
    srcs=glob([
        "Sources/protoc-gen-grpc-swift/*.swift",
    ]),
    visibility=["//visibility:public"],
    deps=[
        "@com_github_apple_swift_protobuf//:SwiftProtobuf",
        "@com_github_apple_swift_protobuf//:SwiftProtobufPluginLibrary",
    ],
)
